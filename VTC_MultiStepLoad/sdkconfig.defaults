## VTC_MultiStepLoad/sdkconfig.defaults
```kconfig
#
#
#
# Bootloader config
#
CONFIG_BOOTLOADER_SPI_WP_PIN=7
# Serial flasher config
#
CONFIG_ESPTOOLPY_FLASHMODE_QIO=y
CONFIG_ESPTOOLPY_FLASHSIZE_4MB=y
CONFIG_ESPTOOLPY_FLASHSIZE="4MB"
#
# FreeRTOS
#
CONFIG_FREERTOS_HZ=200
CONFIG_FLASHMODE_QIO=y
```
